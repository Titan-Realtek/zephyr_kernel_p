/*
 * SPDX-License-Identifier: Apache-2.0
 *
 * Copyright (c) 2026 Realtek Semiconductor Corporation, SIBG-SD7
 *
 * RTS5918B (7148) SoC devicetree.
 * Inherits everything from rts5918.dtsi (7088); override only the
 * nodes that differ on 7148 below this include.
 */

#include <realtek/ec/rts5918.dtsi>

/* 7148-specific overrides go here (e.g. sram0 size, mbx, ps2). */
