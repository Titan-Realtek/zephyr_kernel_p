## dts/bindings/counter/realtek,rts5918-timer.yaml
```yaml
# Copyright (c) 2023, Realtek Corporation
# SPDX-License-Identifier: Apache-2.0

description: Realtek RTS5918 32bit timer

compatible: "realtek,rts5918-timer"

include: rtc.yaml

properties:
    reg:
      required: true

    interrupts:
      required: true

    max-value:
      type: int
      required: false
      description: Maximum counter value the instance can handle

    clock-frequency:
      required: false

    prescaler:
      type: int
      required: false
      description: Timer frequency equals clock-frequency divided by the prescaler value
```

## dts/bindings/espi/realtek,rts5918-espi.yaml
```yaml
# Copyright (c) 2025, Realtek, SIBG-SD7
# SPDX-License-Identifier: Apache-2.0

description: Realtek RTS5918 eSPI controller

compatible: "realtek,rts5918-espi"

include: [espi-controller.yaml, pinctrl-device.yaml]

properties:
  reg:
    description: mmio register space
    required: false

  pinctrl-0:
    required: false

  pinctrl-names:
    required: false
```

## dts/bindings/flash_controller/realtek,rts5918-flash-controller.yaml
```yaml
# SPDX-License-Identifier: Apache-2.0
#
# Copyright (c) 2025 Realtek Semiconductor Corporation, SIBG-SD7
#

description: Realtek RTS5918 flash controller

compatible: "realtek,rts5918-flash-controller"

include: [flash-controller.yaml, pinctrl-device.yaml]

properties:
  enter-4byte-addr:
    type: int
    description: |
      Enter 4-Byte Addressing value from JESD216 BFP DW16

      This property is ignored if the device is configured to use SFDP data
      from the sfdp-bfp property (CONFIG_SPI_NOR_SFDP_DEVICETREE) or to read
      SFDP properties at runtime (CONFIG_SPI_NOR_SFDP_RUNTIME).

      For CONFIG_SPI_NOR_SFDP_MINIMAL this is the 8-bit value from bits 31:24
      of DW16 identifying ways a device can be placed into 4-byte addressing
      mode.  If provided as a non-zero value the driver assumes that 4-byte
      addressing is require to access the full address range, and
      automatically puts the device into 4-byte address mode when the device
      is initialized.
```

## dts/bindings/gpio/nxp,pcal6416a.yaml
```yaml
# Copyright (c) 2023 SILA Embedded Solutions GmbH
# SPDX-License-Identifier: Apache-2.0

description: PCAL6416A 16-bit I2C-based I/O expander

compatible: "nxp,pcal6416a"

include: nxp,pcal64xxa-base.yaml

properties:
  ngpios:
    required: true
    const: 16
  index:
    type: int
    description: |
      Logical bank index used by ecfw-zephyr middle layer
      (mdl_gpio_hub) to pack (port, pin) into uint32_t. Optional.
```

## dts/bindings/gpio/realtek,rts5918-gpio.yaml
```yaml
# SPDX-License-Identifier: Apache-2.0
#
# Copyright (c) 2024 Realtek Semiconductor Corporation, SIBG-SD7
#

description: Realtek RTS5918 GPIO

compatible: "realtek,rts5918-gpio"

include: [gpio-controller.yaml, base.yaml]

properties:
  reg:
    required: true
  index:
    type: int
    description: |
      Logical index of this GPIO bank, used by the ecfw-zephyr middle
      layer (mdl_gpio_hub) to pack (port, pin) into a single uint32_t
      via DT_PROP(ctlr, index).

gpio-cells:
  - pin
  - flags
```

## dts/bindings/gpio/vnd,lenovo-iox-virt-port.yaml
```yaml
# Copyright (c) 2026 Bison RTS5918 EC porting
# SPDX-License-Identifier: Apache-2.0

description: |
  Virtual port-byte node for a Lenovo Nct5635-style I/O expander chip
  (KTS1622 / NCT5635Y / etc., 16-pin × 8-bit-per-byte). No Zephyr device
  driver — exists only as a devicetree reference target so the
  ecfw-zephyr/scripts/gen_poc_from_csv.py overlay generator can encode
  pins via the `index` property to match what
  ecfw-zephyr/Jupiter/peripheral/Nct5635/nct5635.c::IoSetExpander()
  expects (port_number = chip_index * 2 + port_byte; bit_in_byte = 0..7).

  The Lenovo source code (Jupiter/IoPort.c::IoSet → Nct5635 driver)
  decodes the encoded `enum gpio_idx` value as:

      port_number  = (idx >> 8) & 0x1FF   /* 0..3 for 2 chips */
      bit_in_byte  = idx & 0x1F           /* 0..7 */

  Standard Zephyr GPIO devicetree encoding via `gpios = <&node N>`
  uses `(DT_PROP(node, index) << 8) | (DT_GPIO_PIN << 0)`. By making
  each node represent ONE byte of an expander chip and setting `index`
  to the Lenovo-internal port_number, the standard encoding produces
  the exact value Nct5635.c expects, with no driver-side translation.

  Bison maps four such virtual nodes onto two physical KTS1622 chips
  on i2c_4:

      expander1_p0: index = 0   (U5601 / KTS1622 @ 0x20, P0)
      expander1_p1: index = 1   (U5601 / KTS1622 @ 0x20, P1)
      expander2_p0: index = 2   (U5602 / KTS1622 @ 0x21, P0)
      expander2_p1: index = 3   (U5602 / KTS1622 @ 0x21, P1)

  The actual I2C addresses are configured separately in
  Jupiter/peripheral/Nct5635/Nct5635.h via EXPANDER1_ADDRESS /
  EXPANDER2_ADDRESS.

compatible: "vnd,lenovo-iox-virt-port"

include: [gpio-controller.yaml, base.yaml]

properties:
  "#gpio-cells":
    const: 2
  index:
    type: int
    required: true
    description: |
      Lenovo internal port_number = chip_index * 2 + port_byte_index.
      Used by GPIO_VAL_FROM_NODE in middle/mdl_gpio_hub.h to encode
      the port slot of each pin in `enum gpio_idx`.
  ngpios:
    type: int
    required: true
    description: Number of GPIO lines on this port byte (always 8).

gpio-cells:
  - pin
  - flags
```

## dts/bindings/i2c/realtek,rts5918-i2c.yaml
```yaml
# Copyright (c) 2025 Realtek, SIBG-SD7
# SPDX-License-Identifier: Apache-2.0

description: Realtek RTS5918 I2C node

compatible: "realtek,rts5918-i2c"

include: base.yaml

properties:
  dw-i2c-dev:
    type: phandle
    required: false
    description: |
      DesignWare i2c device

  sda-timeout-value:
    type: int
    default: 30
    description: |
      Describe the SDA stuck at low timeout value, unit in ms

  scl-timeout-value:
    type: int
    default: 30
    description: |
      Describe the SCL stuck at low timeout value, unit in ms

  sda-gpio-pin:
    type: int
    default: 0
    description: |
      Describe the SDA gpio number used by the bus-recovery bit-bang
      fallback in i2c_rts5918_recover_bus(). Default 0 means the
      recovery fallback is not configured for this bus and would
      target gpio0 if invoked. Phase 10.10: only the SCCON clock
      enable path matters for normal i2c traffic; bus recovery is
      a future improvement.

  scl-gpio-pin:
    type: int
    default: 0
    description: |
      Describe the SCL gpio number used by the bus-recovery bit-bang
      fallback. Same semantics as sda-gpio-pin (Phase 10.10).
```

## dts/bindings/i3c/realtek,rts5918-i3c-target.yaml
```yaml
# Copyright (c) 2026 Realtek Semiconductor Corp.
# SPDX-License-Identifier: Apache-2.0

description: Realtek RTS5918 I3C target used for on-board controller/target validation

compatible: "realtek,rts5918-i3c-target"

include: [i3c-device.yaml]
```

## dts/bindings/i3c/realtek,rts5918-i3c.yaml
```yaml
# Copyright (c) 2026 Realtek Semiconductor Corp.
# SPDX-License-Identifier: Apache-2.0

description: Realtek RTS5918 I3C controller/target

compatible: "realtek,rts5918-i3c"

include: [i3c-controller.yaml, pinctrl-device.yaml]

properties:
  reg:
    required: true

  interrupts:
    required: true

  clocks:
    required: true
    description: SCCON gate for the I3C IP clock.

  target-mode:
    type: boolean
    description: Configure this I3C instance as a target instead of a primary controller.

  static-addr:
    type: int
    description: Static address used when target-mode is enabled.

  primary-controller-da:
    type: int
    description: Preferred dynamic address for the primary controller.

  pid-msb:
    type: int
    description: Upper 16 bits of the 48-bit target provisioned ID.

  pid-lsb:
    type: int
    description: Lower 32 bits of the 48-bit target provisioned ID.

  bcr:
    type: int
    description: Target Bus Characteristics Register value.

  dcr:
    type: int
    description: Target Device Characteristics Register value.

  max-read-len:
    type: int
    description: Target maximum read length.

  max-write-len:
    type: int
    description: Target maximum write length.
```

## dts/bindings/input/realtek,rts5918-kbd.yaml
```yaml
# Copyright (c) 2021 REALTEK Corporation. All Rights Reserved.
# SPDX-License-Identifier: Apache-2.0

description: REALTEK rts5918 keyboard matrix controller

compatible: "realtek,rts5918-kbd"

include: [kbd-matrix-common.yaml, pinctrl-device.yaml]

properties:
  reg:
    required: true

  interrupts:
    required: true

  pinctrl-0:
    required: false

  pinctrl-names:
    required: false

  row-size:
    required: false

  col-size:
    required: false
```

## dts/bindings/memory-controllers/realtek,rts5918-bbram.yaml
```yaml
# Copyright (c) 2025, Realtek, SIBG-SD7
# SPDX-License-Identifier: Apache-2.0

description: Realtek, RTS5918 Battery Backed RAM node

compatible: "realtek,rts5918-bbram"

include: base.yaml

properties:
  reg:
    required: true
```

## dts/bindings/pinctrl/realtek,rts5918-pinctrl.yaml
```yaml
# SPDX-License-Identifier: Apache-2.0
#
# Copyright (c) 2024 Realtek Semiconductor Corporation, SIBG-SD7
#

description: |
     This binding gives a base representation of the pins configuration

compatible: "realtek,rts5918-pinctrl"

include: [base.yaml, pinctrl-device.yaml, pincfg-node.yaml]

properties:
  reg:
    required: true

child-binding:
  description: |
    This binding gives a base representation of the pins configuration

  include:
    - name: pincfg-node.yaml
      property-allowlist:
        
  properties:
    pinmux:
      type: int
      required: false
      description: Pinmux selection
    voltage-1v8-enable:
      type: boolean
      description: |
        Configure the pin to operate in 1.8 V mode rather than 3.3 V.
        Used by rts5918 JTAG / SWJ pins which need 1.8 V signalling.
```

## dts/bindings/ps2/realtek,rts5918-ps2.yaml
```yaml
# Copyright (c) 2019, Intel Corporation
# SPDX-License-Identifier: Apache-2.0

description: Realtek RTS5918 PS/2 controller

compatible: "realtek,rts5918-ps2"

include: [base.yaml, pinctrl-device.yaml]

properties:
  reg:
    required: true

  interrupts:
    required: true
```

## dts/bindings/pwm/realtek,rts5918-pwm.yaml
```yaml
# Copyright (c) 2025, Realtek, SIBG-SD7
# SPDX-License-Identifier: Apache-2.0

description: Realtek RTS5918 PWM

include: [pwm-controller.yaml, base.yaml, pinctrl-device.yaml]

compatible: "realtek,rts5918-pwm"

properties:
    reg:
      required: true

    pwm-invert:
      type: boolean

    "#pwm-cells":
      const: 3

pwm-cells:
    - channel
    - period
    - flags
```

## dts/bindings/rtc/realtek,rts5918-rtc.yaml
```yaml
# Copyright (c) 2025 Realtek, SIBG-SD7
# SPDX-License-Identifier: Apache-2.0

description: RTC on Realtek RTS5918 EC

compatible: "realtek,rts5918-rtc"

include: rtc-device.yaml

properties:
  reg:
    required: true
```

## dts/bindings/serial/realtek,rts5918-uart.yaml
```yaml
# SPDX-License-Identifier: Apache-2.0
#
# Copyright (c) 2024 Realtek Semiconductor Corporation, SIBG-SD7
#

description: Realtek RTS5918 UART

compatible: "realtek,rts5918-uart"

include: [uart-controller.yaml, pinctrl-device.yaml]

properties:
  reg:
    required: true

  port:
    type: int
    required: false

  pinctrl-0:
    required: false

  pinctrl-names:
    required: false
```

## dts/bindings/tach/realtek,rts5918-tach.yaml
```yaml
# SPDX-License-Identifier: Apache-2.0
#
# Copyright (c) 2025 Realtek Semiconductor Corporation, SIBG-SD7
#

description: Realtek rts5918 tachometer controller

compatible: "realtek,rts5918-tach"

include: [tach.yaml, pinctrl-device.yaml, sensor-device.yaml]

properties:
  reg:
    required: true

  interrupts:
    required: true

  pinctrl-0:
    required: false

  pinctrl-names:
    required: false

  pulses-per-round:
    type: int
    required: false
    description: number of pulses per round of tachometer's input
```

## dts/bindings/timer/realtek,rts5918-rtmr.yaml
```yaml
# SPDX-License-Identifier: Apache-2.0
#
# Copyright (c) 2024 Realtek Semiconductor Corporation, SIBG-SD7
#

description: RTOS Timer on Realtek RTS5918 EC

compatible: "realtek,rts5918-rtmr"

include: base.yaml

properties:
  reg:
    required: true

  interrupts:
    required: true
```

## dts/bindings/watchdog/realtek,rts5918-watchdog.yaml
```yaml
# Copyright (c) 2025 Realtek, SIBG-SD7
# SPDX-License-Identifier: Apache-2.0

description: Realtek RTS5918 watchdog timer

include: base.yaml

compatible: "realtek,rts5918-watchdog"

properties:
  reg:
    required: true

  interrupts:
    required: true

  clk-divider:
    type: int
    description: Watchdog clock divider
    required: false
```
