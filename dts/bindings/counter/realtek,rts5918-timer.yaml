## soc/realtek/ec/Kconfig
```kconfig
# SPDX-License-Identifier: Apache-2.0
#
# Copyright (c) 2024 Realtek Semiconductor Corporation, SIBG-SD7
#

if SOC_FAMILY_REALTEK_EC

if SOC_SERIES_RTS5918
    config REALTEK_IS_5918
        bool
        default y

    menuconfig REALTEK_RTS5918_IMG_HEADER
        bool "The output binary with RTS5918 image header"
        help
          Enable this to invoke tool for RTS5918 image header.
endif

if REALTEK_RTS5918_IMG_HEADER

config REALTEK_HEADER_CHIP
	string
	default "RTS5918" if SOC_RTS5918

config REALTEK_RTS_HEADER_COMBINE
    bool "Combine binary and header into new BIN file"
    default y
	help
	  Combine a "raw" binary and header information into zephyr/zephyr.rts5918.bin .
	  The name of this file can be customized with CONFIG_KERNEL_BIN_NAME.

config REALTEK_RTS_IMG_HEADER_LOAD_ADDRESS
    string "Image header load address"
    default "0x200384E0" if SOC_RTS5918
    default "0x20000000"
	help
	  The loading address where the RTS5918 ROM code loads firmware image from flash to RAM.

config REALTEK_RTS_IMG_HEADER_SPI_MODE
	int "Flash SPI Mode used by the SPI flash"
	range 0 3
	default 0
	help
	  Choice the SPI mode used by the SPI flash.

choice REALTEK_RTS_IMG_HEADER_SPI_FREQ_MHZ_CHOICE
    prompt "Clock frequency to use for SPI flash"
    default REALTEK_RTS_IMG_HEADER_SPI_FREQ_MHZ_DIV1
	help
	  This selects the SPI clock frequency that will be used for loading
	  firmware binary from flash to RAM.

config REALTEK_RTS_IMG_HEADER_SPI_FREQ_MHZ_DIV1
	bool "SPI flash clock frequency is SPIC engine clock divide 1"

config REALTEK_RTS_IMG_HEADER_SPI_FREQ_MHZ_DIV2
	bool "SPI flash clock frequency is SPIC engine clock divide 2"

config REALTEK_RTS_IMG_HEADER_SPI_FREQ_MHZ_DIV4
	bool "SPI flash clock frequency is SPIC engine clock divide 4"

config REALTEK_RTS_IMG_HEADER_SPI_FREQ_MHZ_DIV8
	bool "SPI flash clock frequency is SPIC engine clock divide 8"

endchoice # REALTEK_RTS_IMG_HEADER_SPI_FREQ_MHZ_CHOICE

config REALTEK_RTS_IMG_HEADER_SPI_FREQ_MHZ
	int
	default 0 if REALTEK_RTS_IMG_HEADER_SPI_FREQ_MHZ_DIV1
	default 1 if REALTEK_RTS_IMG_HEADER_SPI_FREQ_MHZ_DIV2
	default 2 if REALTEK_RTS_IMG_HEADER_SPI_FREQ_MHZ_DIV4
	default 3 if REALTEK_RTS_IMG_HEADER_SPI_FREQ_MHZ_DIV8

choice REALTEK_RTS_IMG_HEADER_SPI_READ_CMD_CHOICE
	prompt "Read command used by the SPI flash"
	default REALTEK_RTS_IMG_HEADER_SPI_READ_CMD_QUAD
	help
	  This sets the reading command that can be used by the SPI flash.
	  Suppot normal read / fast read / dual read / quad read

config REALTEK_RTS_IMG_HEADER_SPI_READ_CMD_NORMAL
	bool "Use normal read (0x03) to access SPI flash"

config REALTEK_RTS_IMG_HEADER_SPI_READ_CMD_FAST
	bool "Use fast read (0x0B) to access SPI flash"

config REALTEK_RTS_IMG_HEADER_SPI_READ_CMD_DUAL
	bool "Use dual read (0x3B) to access SPI flash"

config REALTEK_RTS_IMG_HEADER_SPI_READ_CMD_QUAD
	bool "Use quad read (0x6B) to access SPI flash"

endchoice # REALTEK_RTS_IMG_HEADER_SPI_READ_CMD_CHOICE

config REALTEK_RTS_IMG_HEADER_SPI_READ_CMD
	string
	default "0x03" if REALTEK_RTS_IMG_HEADER_SPI_READ_CMD_NORMAL
	default "0x0B" if REALTEK_RTS_IMG_HEADER_SPI_READ_CMD_FAST
	default "0x3B" if REALTEK_RTS_IMG_HEADER_SPI_READ_CMD_DUAL
	default "0x6B" if REALTEK_RTS_IMG_HEADER_SPI_READ_CMD_QUAD

endif # REALTEK_RTS5918_IMG_HEADER

# Select SoC Part No. and configuration options
rsource "*/Kconfig"

endif # SOC_FAMILY_REALTEK_EC
```
