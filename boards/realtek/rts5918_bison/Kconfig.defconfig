## boards/realtek/rts5918_bison/Kconfig.defconfig
```kconfig
# SPDX-License-Identifier: Apache-2.0
#
# Copyright (c) 2026 Realtek Semiconductor Corporation, SIBG-SD7
#

if BOARD_RTS5918_BISON

config BOARD
	default "rts5918_bison"

if REALTEK_RTS5918_RTMR

config SYS_CLOCK_HW_CYCLES_PER_SEC
	default 32768

config SYS_CLOCK_TICKS_PER_SEC
	default 32768

endif # REALTEK_RTS5918_RTMR

config TICKLESS_KERNEL
	default y

endif # BOARD_RTS5918_BISON
```

## boards/realtek/rts5918_bison/Kconfig.rts5918_bison
```kconfig
# SPDX-License-Identifier: Apache-2.0
#
# Copyright (c) 2026 Realtek Semiconductor Corporation, SIBG-SD7
#

config BOARD_RTS5918_BISON
	select SOC_RTS5918
	select CPU_HAS_FPU
	select HAS_PM
```

## boards/realtek/rts5918_evb/rts5918_evb_defconfig
```kconfig
# SPDX-License-Identifier: Apache-2.0
#
# Copyright (c) 2024 Realtek Semiconductor Corporation, SIBG-SD7
#

# Enable rts5918 image tool
#CONFIG_REALTEK_rts5918_BOOTROM_HEADER=y
CONFIG_REALTEK_RTS5918_IMG_HEADER=y

# Serial Driver
CONFIG_SERIAL=y
CONFIG_UART_NS16550=y
#CONFIG_UART_INTERRUPT_DRIVEN=y

# Console
CONFIG_CONSOLE=y
CONFIG_UART_CONSOLE=y

# Enable GPIO
CONFIG_GPIO=y
```

## drivers/adc/Kconfig.rts5918
```kconfig
# Copyright (c) 2025, Realtek, SIBG-SD7
# SPDX-License-Identifier: Apache-2.0

config ADC_REALTEK_RTS5918
	bool "Realtek RTS5918 ADC drivers"
	default y
	depends on DT_HAS_REALTEK_RTS5918_ADC_ENABLED
	select PINCTRL
	help
	  This option enables the ADC driver for Realtek RTS5918 of processors.
```

## drivers/bbram/Kconfig.rts5918
```kconfig
# Copyright (c) 2025, Realtek, SIBG-SD7
# SPDX-License-Identifier: Apache-2.0

config BBRAM_RTS5918
	bool "Realtek RTS5918 Battery-backed RAM drivers"
	default y
	depends on DT_HAS_REALTEK_RTS5918_BBRAM_ENABLED
	help
	  This option enables the BBRAM driver for Realtek RTS5918 of processors.
```

## drivers/counter/Kconfig.rts5918
```kconfig
# Realtek counter configuration options

# Copyright (c) 2023 Realtek Corporation
# SPDX-License-Identifier: Apache-2.0

config COUNTER_REALTEK_RTS5918
	bool "Realtek rts5918 series counter driver"
	default y
	depends on DT_HAS_REALTEK_RTS5918_TIMER_ENABLED
	help
	  Enable counter driver for Realtek RTS5918 MCU series. Such driver
	  will expose the basic timer devices present on the MCU.
```

## drivers/counter/Kconfig.rts5918_slwtmr
```kconfig
# Realtek counter configuration options

# Copyright (c) 2023 Realtek Corporation
# SPDX-License-Identifier: Apache-2.0

config COUNTER_REALTEK_RTS5918_SLWTMR
	bool "Realtek rts5918 series slow timer counter driver"
	default y
	depends on DT_HAS_REALTEK_RTS5918_SLWTIMER_ENABLED
	help
	  Enable counter driver for Realtek RTS5918 MCU series. Such driver
	  will expose the slow timer devices present on the MCU.
```

## drivers/espi/Kconfig.rts5918
```kconfig
# Copyright (c) 2023, Realtek, SIBG-SD7
# SPDX-License-Identifier: Apache-2.0

config ESPI_RTS5918
	bool "Realtek RTS5918 eSPI Driver"
	default y
	depends on DT_HAS_REALTEK_RTS5918_ESPI_ENABLED
	select KERNEL_MEM_POOL
	help
	  Enable the Realtek RTS5918 eSPI driver.

config MAF_BUFFER_SIZE
	int "eSPI Flash Channel MAF Buffer Size"
	default 512
	depends on ESPI_FLASH_CHANNEL
	help
	  The buffer size used for MAF Tr of flash channel.

config ESPI_RTS5918_IOSHORT_RW
	bool "Realtek RTS5918 IORW"
	default n
	help
	  Enable RTS5918 eSPI Peripheral IORW

config ESPI_PERIPHERAL_PM0_OBE_EVT_DATA
	bool "Enable Promt0 event"
	default n

config ESPI_PERIPHERAL_HOST_CMD_PM1_PARAM_PORT_NUM
	hex "Host I/O peripheral port number for ec host command parameters"
	depends on ESPI_PERIPHERAL_EC_HOST_CMD
	default 0x0086

config ESPI_PERIPHERAL_PM1_OBE_EVT_DATA
	bool "Enable Promt0 event"
	default n

config ESPI_PERIPHERAL_HOST_CMD_PM2_PARAM_PORT_NUM
	hex "Host I/O peripheral port number for ec host command parameters"
	depends on ESPI_PERIPHERAL_EC_HOST_CMD
	default 0x0630

config ESPI_PERIPHERAL_PM2_OBE_EVT_DATA
	bool "Enable Promt0 event"
	default n

config ESPI_PERIPHERAL_HOST_CMD_PM3_PARAM_PORT_NUM
	hex "Host I/O peripheral port number for ec host command parameters"
	depends on ESPI_PERIPHERAL_EC_HOST_CMD
	default 0x0618

config ESPI_PERIPHERAL_PM3_OBE_EVT_DATA
	bool "Enable Promt0 event"
	default n

config ESPI_RTS5918_TYPE_A
	bool "Enable for RTS5918 type-A"
	default n

if ESPI_RTS5918

	config ESPI_OOB_CHANNEL
		default y

	config ESPI_FLASH_CHANNEL
		default y

	config ESPI_PERIPHERAL_8042_KBC
		default y

endif # ESPI_RTS5918
```

## drivers/flash/Kconfig.rts5918
```kconfig
# SPDX-License-Identifier: Apache-2.0
#
# Copyright (c) 2025 Realtek Semiconductor Corporation, SIBG-SD7
#

config SOC_FLASH_RTS5918
	bool "Realtek RTS5918 flash driver"
	default y
	depends on DT_HAS_REALTEK_RTS5918_FLASH_CONTROLLER_ENABLED
	select FLASH_HAS_PAGE_LAYOUT
	select FLASH_HAS_DRIVER_ENABLED
	select FLASH_HAS_EXPLICIT_ERASE
	select FLASH_HAS_EX_OP
	select HAS_FLASH_LOAD_OFFSET
	help
	  The flash driver includes support for read, write and
	  erase flash operations. It also supports protection.
	  The it8xxx2 flash size is 1M byte.

config FLASH_RTS5918_SAFS
	bool "change pin to external CS0 and set into 4 byte mode"
	default n
```

## drivers/gpio/Kconfig.rts5918
```kconfig
# SPDX-License-Identifier: Apache-2.0
#
# Copyright (c) 2024 Realtek Semiconductor Corporation, SIBG-SD7
#

config GPIO_RTS5918
	bool "Realtek embedded controller (EC) gpio driver"
	depends on SOC_SERIES_RTS5918
	default y if DT_HAS_REALTEK_RTS5918_GPIO_ENABLED
	help
	  Enable support for Realtek GPIO controller.
```

## drivers/i2c/Kconfig.rts5918
```kconfig
# Copyright (c) 2025 Realtek, SIBG-SD7
# SPDX-License-Identifier: Apache-2.0

menuconfig I2C_RTS5918
	bool "Realtek RTS5918 I2C support"
	default y
	depends on DT_HAS_REALTEK_RTS5918_I2C_ENABLED
	select I2C_ALLOW_NO_STOP_TRANSACTIONS
	help
	  Enable the Realtek RTS5918 I2C driver

config I2C_RTS5918_INIT_PRIORITY
	int "RTS5918 Init priority"
	depends on I2C_RTS5918
	default 45
	help
	  I2C device driver initialization priority.

	  Phase 10.10: must be LESS than CONFIG_I2C_INIT_PRIORITY (default
	  50, the DesignWare driver). The RTS5918 wrapper enables the
	  SCCON IPCLK1__I2Cn clock bit; the DW driver then reads the
	  controller magic key at i2c_dw.c:1101 to verify register access.
	  If the wrapper runs after dw_init, dw reads garbage from the
	  power-gated controller and aborts with -EIO, leaving every i2c
	  transaction broken at runtime.

config I2C_ALLOW_NO_STOP_TRANSACTIONS
	bool "Allows I2C transfers with no STOP on the last transaction [DEPRECATED]"
	default y
	help
	  Allow I2C transactions with no STOP on the last message. This is
	  unsupported and can leave the bus in an unexpected state. The option
	  will be removed in Zephyr 4.1.
```

## drivers/i3c/Kconfig.realtek
```kconfig
# Realtek I3C driver configuration options
#
# SPDX-License-Identifier: Apache-2.0

DT_COMPAT_REALTEK_RTS5918_I3C := realtek,rts5918-i3c

module = I3C_REALTEK
module-str = i3c-realtek
source "subsys/logging/Kconfig.template.log_config"

config I3C_REALTEK
	bool "Realtek I3C driver"
	depends on DT_HAS_REALTEK_RTS5918_I3C_ENABLED
	select I3C_IBI_WORKQUEUE if I3C_USE_IBI
	select RTK_I3C
	select RTK_I3C_CTRL
	select RTK_I3C_TAGT
	select RTK_I3C_IBI if I3C_USE_IBI
	default y
	help
	  Enable Realtek I3C controller/target driver.

menuconfig RTK_I3C
	bool "Realtek RTK I3C IP core"
	depends on I3C_REALTEK
	help
	  Vendored RTK I3C IP core. Selected automatically by I3C_REALTEK.

if RTK_I3C

config RTK_I3C_CTRL
	bool

config RTK_I3C_TAGT
	bool

config RTK_I3C_IBI
	bool

config RTK_I3C_DMA
	bool "Enable RTK I3C DMA handshaking"
	help
	  Enable the RTK I3C DMA data path. Leave disabled unless the SoC DMA
	  integration and DMA shim are available.

config RTK_I3C_CORE_LOG
	bool "Enable RTK I3C core log"
	default y

config RTK_I3C_CORE_LOG_LEVEL
	int "RTK I3C core log level"
	range 0 5
	depends on RTK_I3C_CORE_LOG
	default 0
	help
	  0: off, 1: error, 2: warning, 3: info, 4: debug, 5: register.

config RTK_I3C_COSIM
	bool "Enable RTK I3C co-simulation log"

endif # RTK_I3C
```

## drivers/i3c/Kconfig.realtek_rts5918
```kconfig
# Realtek RTS5918 I3C driver configuration options
#
# SPDX-License-Identifier: Apache-2.0

DT_COMPAT_REALTEK_RTS5918_I3C := realtek,rts5918-i3c

module = I3C_REALTEK_RTS5918
module-str = i3c-realtek-rts5918
source "subsys/logging/Kconfig.template.log_config"

config I3C_REALTEK_RTS5918
	bool "Realtek RTS5918 I3C driver"
	depends on DT_HAS_REALTEK_RTS5918_I3C_ENABLED
	select I3C_IBI_WORKQUEUE if I3C_USE_IBI
	select RTS5918_I3C
	select RTS5918_I3C_CTRL
	select RTS5918_I3C_TAGT
	select RTS5918_I3C_IBI if I3C_USE_IBI
	default y
	help
	  Enable Realtek RTS5918 I3C controller/target driver.

config RTS5918_I3C
	bool

config RTS5918_I3C_CTRL
	bool
	depends on RTS5918_I3C

config RTS5918_I3C_TAGT
	bool
	depends on RTS5918_I3C

config RTS5918_I3C_IBI
	bool
	depends on RTS5918_I3C

config RTS5918_I3C_DMA
	bool "Enable RTS5918 I3C DMA handshaking"
	depends on I3C_REALTEK_RTS5918
	help
	  Enable the RTS5918 I3C DMA data path. Leave disabled unless the SoC DMA
	  integration and DMA shim are available.

config RTS5918_I3C_CORE_LOG
	bool "Enable RTS5918 I3C core log"
	depends on I3C_REALTEK_RTS5918
	default y

config RTS5918_I3C_CORE_LOG_LEVEL
	int "RTS5918 I3C core log level"
	range 0 5
	depends on RTS5918_I3C_CORE_LOG
	default 3
	help
	  0: off, 1: error, 2: warning, 3: info, 4: debug, 5: register.

config RTS5918_I3C_COSIM
	bool "Enable RTS5918 I3C co-simulation log"
	depends on I3C_REALTEK_RTS5918
```

## drivers/pinctrl/Kconfig.realtek_rts5918
```kconfig
# SPDX-License-Identifier: Apache-2.0
#
# Copyright (c) 2024 Realtek Semiconductor Corporation, SIBG-SD7
#

config PINCTRL_REALTEK_RTS5918
	bool "Pin controller driver for REALTEK RTS MCUs"
	default y if DT_HAS_REALTEK_RTS5918_PINCTRL_ENABLED
	help
	  Enable pin controller driver for REALTEK RTS MCUs
```

## drivers/ps2/Kconfig.rts5918
```kconfig
# RTS5918 PS2 configuration options

# Copyright (c) 2025 Realtek Semiconductor Corporation, SIBG-SD7
# SPDX-License-Identifier: Apache-2.0

config PS2_REALTEK_RTS5918
	bool "Realtek RTS5918 embedded controller (EC) PS2 driver"
	depends on DT_HAS_REALTEK_RTS5918_PS2_ENABLED
	default y
	help
	  Enable the RTS5918 PS2 driver. The RTS5918 has a single PS/2
	  controller (ps2_2 @ 0x40254400) that provides one quasi-bidirectional
	  PS/2 channel suitable for an internal pointing device (TrackPoint).

	  The driver implements the standard Zephyr ps2_* API (config / write
	  / enable_callback / disable_callback). RX is callback-driven from
	  the controller IRQ; TX is blocking on a tx_sync_sem until the
	  Transaction Done Status interrupt fires.

config PS2_REALTEK_FW_INHIBIT
	bool "Enable PS2 FW inhibit"
	default y
```

## drivers/pwm/Kconfig.rts5918
```kconfig
# Copyright (c) 2025, Realtek, SIBG-SD7
# SPDX-License-Identifier: Apache-2.0

config PWM_REALTEK_RTS5918
	bool "Realtek RTS5918 PWM Driver"
	default y
	depends on DT_HAS_REALTEK_RTS5918_PWM_ENABLED
	help
	  Enable PWM driver for Realtek RTS5918 EC.
```

## drivers/rtc/Kconfig.rts5918
```kconfig
# Copyright (c) 2025, Realtek, SIBG-SD7
# SPDX-License-Identifier: Apache-2.0

config RTC_REALTEK_RTS5918
	bool "Realtek RTS5918 rtc driver"
	default y
	depends on CLOCK_CONTROL
	depends on DT_HAS_REALTEK_RTS5918_RTC_ENABLED
	help
	  Enable support for Realtek RTC driver.
```

## drivers/sensor/realtek/rts5918/Kconfig
```kconfig
# Copyright (c) 2025, Realtek, SIBG-SD7
# SPDX-License-Identifier: Apache-2.0

config TACH_RTS5918
	bool "RTS5918 Tachometer sensor"
	default y
	depends on DT_HAS_REALTEK_RTS5918_TACH_ENABLED
	help
	  Enable the Realtek RTS5918 tachometer sensor.
```

## drivers/serial/Kconfig.realtek_rts5918
```kconfig
# SPDX-License-Identifier: Apache-2.0
#
# Copyright (c) 2024 Realtek Semiconductor Corporation, SIBG-SD7
#

config UART_RTS5918
	bool "UART driver for Realtek RTS5918 EC"
	depends on SOC_SERIES_RTS5918
	default y if DT_HAS_REALTEK_RTS5918_UART_ENABLED
	select PINCTRL
	select CLOCK_CONTROL
	help
	  This option enables the RTS5918 UART wrapper driver.

config UART_RTS5918_INIT_PRIORITY
	int "RTS5918 UART wrapper init priority"
	default 51
	depends on UART_RTS5918
	help
	  Initialization priority for Realtek RTS5918 UART wrapper driver.
```

## drivers/timer/Kconfig.realtek_rts5918_rtmr
```kconfig
# SPDX-License-Identifier: Apache-2.0
#
# Copyright (c) 2024 Realtek Semiconductor Corporation, SIBG-SD7
#

config REALTEK_RTS5918_RTMR
	bool "Realtek RTS5918/RTS5918/RTS5918 RTOS Timer"
	depends on SOC_SERIES_RTS5918 || SOC_SERIES_RTS5918 || SOC_SERIES_RTS5918
	default y if DT_HAS_REALTEK_RTS5918_RTMR_ENABLED
	select TICKLESS_CAPABLE
	select SYSTEM_TIMER_HAS_DISABLE_SUPPORT
	help
	  This module implements a kernel device driver for the Realtek
	  RTS5918/RTS5918/RTS5918 series RTOS timer.
```

## drivers/watchdog/Kconfig.rts5918
```kconfig
# Copyright (c) 2025, Realtek, SIBG-SD7
# SPDX-License-Identifier: Apache-2.0

config WDT_RTS5918
	bool "Realtek RTS5918 Embedded Controller Watchdog Driver"
	default y
	depends on DT_HAS_REALTEK_RTS5918_WATCHDOG_ENABLED
	select HAS_WDT_DISABLE_AT_BOOT
	help
	  This option enables the WDT driver for Realtek RTS5918 family of
	  processors.
```

## dts/bindings/adc/realtek,rts5918-adc.yaml
```yaml
description: Realtek rts5918 ADC

compatible: "realtek,rts5918-adc"

include: [adc-controller.yaml, pinctrl-device.yaml]

properties:
  interrupts:
    required: true

  pinctrl-0:
    required: false

  pinctrl-names:
    required: false

  vref-mv:
    type: int
    default: 3300
    description: The reference voltage of the ADC in mV.

io-channel-cells:
  - input
```
