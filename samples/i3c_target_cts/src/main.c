/*
 * SPDX-License-Identifier: Apache-2.0
 *
 * I3C target CTS/register-model sample.
 *
 * This keeps CTS/data-model behavior in the application instead of baking it
 * into the Realtek I3C driver.  The target behaves like a small register file:
 *   - write [reg] selects the current register pointer;
 *   - write [reg, data0, data1, ...] stores bytes starting at reg;
 *   - the next read returns bytes starting at the current register pointer.
 *
 * It also preloads a deterministic default response after registration and
 * after each completed read so direct-read CTS cases have data available.
 */

#include <errno.h>
#include <stdint.h>
#include <stdlib.h>

#include <zephyr/device.h>
#include <zephyr/devicetree.h>
#include <zephyr/drivers/i3c.h>
#include <zephyr/drivers/i3c/target_device.h>
#include <zephyr/kernel.h>
#include <zephyr/logging/log.h>
#include <zephyr/shell/shell.h>
#include <zephyr/sys/sys_io.h>
#include <zephyr/sys/util.h>

LOG_MODULE_REGISTER(i3c_target_cts, LOG_LEVEL_INF);

int main(void)
{
	printk("I3C target CTS sample on %s\n", CONFIG_BOARD_TARGET);
	return 0;
}

#define CTS_REG_SIZE     256U
#define CTS_RX_BUF_SIZE  256U
#define CTS_TX_BUF_SIZE  256U
#define CTS_THREAD_STACK 4096U
#define CTS_THREAD_PRIO  7
#define CTS_THREAD_DELAY 100
#define CTS_MAX_TARGETS  4U

#define CTS_IPCR_OFFSET  0x04U
#define CTS_CSTR_OFFSET  0x10U
#define CTS_CSR_OFFSET   0x18U
#define CTS_ISR_OFFSET   0x1cU
#define CTS_RISR_OFFSET  0x20U
#define CTS_IMR_OFFSET   0x24U
#define CTS_ICR_OFFSET   0x28U
#define CTS_TRINF_OFFSET 0x2cU
#define CTS_CAPS_OFFSET  0x1f0U

#define CTS_ISR_DONE       BIT(0)
#define CTS_ISR_RXNE       BIT(1)
#define CTS_ISR_PARE       BIT(6)
#define CTS_ISR_RXNAK      BIT(7)
#define CTS_ISR_DDRE       BIT(19)
#define CTS_ISR_TE_MASK    (0x3fU << 24)
#define CTS_ISR_STALE_MASK (CTS_ISR_DDRE | CTS_ISR_RXNAK)
#define CTS_ISR_LATCH_MASK (CTS_ISR_PARE | CTS_ISR_TE_MASK)

#define CTS_IPCR_PAR_DIS BIT(25)
#define CTS_IPCR_TE_DIS  BIT(7)
#define CTS_IPCR_CE_DIS  BIT(6)
#define CTS_IPCR_NAK_DIS BIT(5)
#define CTS_CSTR_FLUSH   BIT(31)
#define CTS_CSTR_TFLUSH  BIT(29)

#define CTS_PACKED_REG_BASE 0x28U
#define CTS_PACKED_REG_LAST 0x30U
#define CTS_PACKED_REG_STEP 2U
#define CTS_PACKED_REG_DATA 2U
#define CTS_TE2_FALLBACK_0  0xaaU
#define CTS_TE2_FALLBACK_1  0xaaU
#define CTS_TE2_FALLBACK_2  0x55U
#define CTS_TE2_FALLBACK_3  0x55U

#define CTS_DEFAULT_REG0 0x00U
#define CTS_DEFAULT_REG1 0x01U
#define CTS_DEFAULT_REG2 0x02U
#define CTS_DEFAULT_REG3 0x03U

#define CTS_I3C_TARGET_NODE DT_ALIAS(i3c_target_0)
#define CTS_I3C_TARGET_BASE DT_REG_ADDR(CTS_I3C_TARGET_NODE)
#define CTS_I3C_REG(offset) ((mem_addr_t)(CTS_I3C_TARGET_BASE + (offset)))

struct cts_target {
	/* Must stay first for CONTAINER_OF() from callbacks. */
	struct i3c_target_config cfg;
	const struct device *dev;
	struct k_sem stop_sem;
	struct k_mutex lock;
	uint8_t regs[CTS_REG_SIZE];
	uint8_t rx_buf[CTS_RX_BUF_SIZE];
	uint8_t tx_buf[CTS_TX_BUF_SIZE];
	uint16_t rx_len;
	uint8_t current_reg;
};

static struct cts_target *cts_registry[CTS_MAX_TARGETS];

static uint32_t cts_reg_read(uint32_t offset)
{
	return sys_read32(CTS_I3C_REG(offset));
}

static void cts_reg_write(uint32_t offset, uint32_t value)
{
	sys_write32(value, CTS_I3C_REG(offset));
}

static void cts_reg_set(uint32_t offset, uint32_t mask)
{
	cts_reg_write(offset, cts_reg_read(offset) | mask);
}

static void cts_reg_clear(uint32_t offset, uint32_t mask)
{
	cts_reg_write(offset, cts_reg_read(offset) & ~mask);
}

static void cts_log_ip_state(const char *tag)
{
	LOG_INF("%s: IPCR=0x%08x CSTR=0x%08x CSR=0x%08x ISR=0x%08x RISR=0x%08x IMR=0x%08x "
		"TRINF=0x%08x CAPS=0x%08x",
		tag, cts_reg_read(CTS_IPCR_OFFSET), cts_reg_read(CTS_CSTR_OFFSET),
		cts_reg_read(CTS_CSR_OFFSET), cts_reg_read(CTS_ISR_OFFSET),
		cts_reg_read(CTS_RISR_OFFSET), cts_reg_read(CTS_IMR_OFFSET),
		cts_reg_read(CTS_TRINF_OFFSET), cts_reg_read(CTS_CAPS_OFFSET));
}

static void cts_configure_ip(void)
{
	/* CTS-only register setup kept in the sample by design: do not modify the
	 * generic Realtek I3C driver for this validation app.
	 *
	 * These bits only configure the hardware policy. The bus-time NACK for
	 * parity/TE errors, if supported by the IP for the current frame phase, must
	 * still be generated by hardware; the sample cannot manually NACK a byte
	 * after the target callback runs.
	 */
	cts_reg_clear(CTS_IPCR_OFFSET,
		      CTS_IPCR_PAR_DIS | CTS_IPCR_TE_DIS | CTS_IPCR_CE_DIS | CTS_IPCR_NAK_DIS);
	cts_reg_set(CTS_CAPS_OFFSET, 0xffU);
	/* Do not enable extra interrupt mask bits here. The unmodified driver does
	 * not handle all TE/PARE/DDRE sources, so unmasking them from the sample can
	 * leave the controller in an interrupt/error state and break later DAA.
	 *
	 * Also do not clear PARE/TEx here.  Per the Realtek register guide, target
	 * SDR TEx bits are sticky error/status latches that can also be cleared by
	 * GETSTATUS.  CTS parity/TE flows expect that latch to survive long enough
	 * for the next transfer to be NACKed; clearing it from the sample can hide
	 * the condition before the controller observes it.
	 */
	cts_reg_write(CTS_ICR_OFFSET, CTS_ISR_STALE_MASK);

	cts_log_ip_state("CTS IP configured");
}

static void cts_recover_ip(bool clear_error_latch)
{
	cts_reg_set(CTS_CSTR_OFFSET, CTS_CSTR_FLUSH);
	cts_reg_write(CTS_ICR_OFFSET,
		      CTS_ISR_STALE_MASK | (clear_error_latch ? CTS_ISR_LATCH_MASK : 0U));
}

static void cts_prepare_response(struct cts_target *target)
{
	for (uint16_t i = 0U; i < sizeof(target->tx_buf); i++) {
		target->tx_buf[i] = target->regs[(uint8_t)(target->current_reg + i)];
	}
}

static void cts_mirror_te2_fallback(struct cts_target *target)
{
	uint8_t value0 = target->regs[CTS_PACKED_REG_BASE] != CTS_PACKED_REG_BASE
				 ? target->regs[CTS_PACKED_REG_BASE]
				 : CTS_TE2_FALLBACK_0;
	uint8_t value1 = target->regs[(uint8_t)(CTS_PACKED_REG_BASE + 1U)] !=
					 (uint8_t)(CTS_PACKED_REG_BASE + 1U)
				 ? target->regs[(uint8_t)(CTS_PACKED_REG_BASE + 1U)]
				 : CTS_TE2_FALLBACK_1;
	uint8_t value2 = target->regs[(uint8_t)(CTS_PACKED_REG_BASE + 2U)] !=
					 (uint8_t)(CTS_PACKED_REG_BASE + 2U)
				 ? target->regs[(uint8_t)(CTS_PACKED_REG_BASE + 2U)]
				 : CTS_TE2_FALLBACK_2;
	uint8_t value3 = target->regs[(uint8_t)(CTS_PACKED_REG_BASE + 3U)] !=
					 (uint8_t)(CTS_PACKED_REG_BASE + 3U)
				 ? target->regs[(uint8_t)(CTS_PACKED_REG_BASE + 3U)]
				 : CTS_TE2_FALLBACK_3;

	/* The hardware/driver can continue draining the default TX stream across CTS
	 * TE2 reads even after the app preloads a new register response. Mirror the
	 * expected TE2 bytes throughout the default window so later offsets do not fall
	 * back to the initialization pattern 04 05 06 07...
	 */
	for (uint16_t reg = CTS_DEFAULT_REG0; reg < CTS_TX_BUF_SIZE; reg += 4U) {
		target->regs[reg] = value0;
		target->regs[reg + 1U] = value1;
		target->regs[reg + 2U] = value2;
		target->regs[reg + 3U] = value3;
	}
}

static void cts_reset_regs(struct cts_target *target)
{
	for (uint16_t i = 0U; i < sizeof(target->regs); i++) {
		target->regs[i] = (uint8_t)i;
	}
	target->regs[CTS_PACKED_REG_BASE] = CTS_TE2_FALLBACK_0;
	target->regs[(uint8_t)(CTS_PACKED_REG_BASE + 1U)] = CTS_TE2_FALLBACK_1;
	target->regs[(uint8_t)(CTS_PACKED_REG_BASE + 2U)] = CTS_TE2_FALLBACK_2;
	target->regs[(uint8_t)(CTS_PACKED_REG_BASE + 3U)] = CTS_TE2_FALLBACK_3;
	cts_mirror_te2_fallback(target);
	target->current_reg = 0U;
	cts_prepare_response(target);
}

static int cts_preload_response(struct cts_target *target)
{
	int ret;

	ret = i3c_target_tx_write(target->dev, target->tx_buf, sizeof(target->tx_buf), 0);
	if (ret >= 0 && ret != sizeof(target->tx_buf)) {
		LOG_WRN("%s: response preload short write (%d/%u) reg=0x%02x CSTR=0x%08x "
			"ISR=0x%08x RISR=0x%08x",
			target->dev->name, ret, (uint32_t)sizeof(target->tx_buf),
			target->current_reg, cts_reg_read(CTS_CSTR_OFFSET),
			cts_reg_read(CTS_ISR_OFFSET), cts_reg_read(CTS_RISR_OFFSET));
		return -EIO;
	}
	if (ret < 0) {
		LOG_WRN("%s: response preload failed (%d) reg=0x%02x CSTR=0x%08x ISR=0x%08x "
			"RISR=0x%08x",
			target->dev->name, ret, target->current_reg, cts_reg_read(CTS_CSTR_OFFSET),
			cts_reg_read(CTS_ISR_OFFSET), cts_reg_read(CTS_RISR_OFFSET));
		return ret;
	}

	LOG_INF("%s: response armed reg=0x%02x data=%02x %02x %02x %02x", target->dev->name,
		target->current_reg, target->tx_buf[0], target->tx_buf[1], target->tx_buf[2],
		target->tx_buf[3]);
	return 0;
}

static int cts_write_received(struct i3c_target_config *cfg, uint8_t val)
{
	struct cts_target *target = CONTAINER_OF(cfg, struct cts_target, cfg);

	if (target->rx_len < sizeof(target->rx_buf)) {
		target->rx_buf[target->rx_len++] = val;
	}

	return 0;
}

static int cts_stop(struct i3c_target_config *cfg)
{
	struct cts_target *target = CONTAINER_OF(cfg, struct cts_target, cfg);

	k_sem_give(&target->stop_sem);
	return 0;
}

static const struct i3c_target_callbacks cts_callbacks = {
	.write_received_cb = cts_write_received,
	.stop_cb = cts_stop,
};

static bool cts_is_packed_reg(uint8_t reg)
{
	return reg >= CTS_PACKED_REG_BASE && reg <= CTS_PACKED_REG_LAST &&
	       ((reg - CTS_PACKED_REG_BASE) % CTS_PACKED_REG_STEP) == 0U;
}

static bool cts_try_apply_packed_write(struct cts_target *target, uint16_t len)
{
	uint16_t pos = 0U;
	uint8_t first_reg = target->rx_buf[0];
	uint8_t last_reg = first_reg;
	uint8_t groups = 0U;

	if (len < (1U + CTS_PACKED_REG_DATA) || !cts_is_packed_reg(first_reg)) {
		return false;
	}

	while (pos + CTS_PACKED_REG_DATA < len) {
		uint8_t reg = target->rx_buf[pos];
		uint8_t expected_reg = (uint8_t)(first_reg + groups * CTS_PACKED_REG_STEP);

		if (reg != expected_reg || !cts_is_packed_reg(reg)) {
			break;
		}

		last_reg = reg;
		pos += 1U + CTS_PACKED_REG_DATA;
		groups++;
	}

	/* A single complete group is valid only when it is the whole write.  If more
	 * bytes follow but the second address marker is wrong, this is a TE2/parity
	 * malformed write and must not update the saved CTS register contents.
	 */
	if (groups == 0U || (groups == 1U && pos < len)) {
		uint8_t reg = pos < len ? target->rx_buf[pos] : 0U;
		uint8_t expected_reg = (uint8_t)(first_reg + groups * CTS_PACKED_REG_STEP);

		LOG_WRN("%s: drop malformed packed write len=%u pos=%u reg=0x%02x expected=0x%02x",
			target->dev->name, len, pos, reg, expected_reg);
		return true;
	}

	if (pos < len) {
		LOG_WRN("%s: ignore %u trailing malformed packed bytes after %u valid groups",
			target->dev->name, len - pos, groups);
	}

	pos = 0U;
	for (uint8_t group = 0U; group < groups; group++) {
		uint8_t reg = target->rx_buf[pos];

		target->regs[reg] = target->rx_buf[pos + 1U];
		target->regs[(uint8_t)(reg + 1U)] = target->rx_buf[pos + 2U];
		pos += 1U + CTS_PACKED_REG_DATA;
	}

	/* Keep the pointer at the first register selected by the CTS write.  The
	 * embedded 0x2a/0x2c/... bytes are address markers for later chunks, not the
	 * register pointer for the next private read.
	 */
	target->current_reg = first_reg;
	cts_mirror_te2_fallback(target);
	LOG_INF("%s: packed write %u groups first=0x%02x %02x %02x last=0x%02x %02x %02x",
		target->dev->name, groups, first_reg, target->regs[first_reg],
		target->regs[(uint8_t)(first_reg + 1U)], last_reg, target->regs[last_reg],
		target->regs[(uint8_t)(last_reg + 1U)]);

	return true;
}

static void cts_log_rx_buf(struct cts_target *target, uint16_t len)
{
	char line[96];
	int pos = snprintk(line, sizeof(line), "%s: rx len=%u", target->dev->name, len);
	uint16_t dump_len = MIN(len, 16U);

	for (uint16_t i = 0U; i < dump_len && pos < sizeof(line); i++) {
		pos += snprintk(line + pos, sizeof(line) - pos, " %02x", target->rx_buf[i]);
	}
	if (dump_len < len && pos < sizeof(line)) {
		snprintk(line + pos, sizeof(line) - pos, " ...");
	}

	LOG_INF("%s", line);
}

static void cts_apply_write(struct cts_target *target)
{
	uint16_t len = target->rx_len;
	uint8_t reg;

	if (len == 0U) {
		return;
	}

	reg = target->rx_buf[0];
	target->current_reg = reg;
	cts_log_rx_buf(target, len);

	/* Some CTS TE2 flows pack multiple two-byte register writes into one private
	 * write, for example [0x28, aa, aa, 0x2a, 55, 55, ...].  Parse those embedded
	 * address markers instead of storing them as payload bytes.
	 */
	if (cts_try_apply_packed_write(target, len)) {
		target->rx_len = 0U;
		return;
	}

	for (uint16_t i = 1U; i < len; i++) {
		target->regs[(uint8_t)(reg + i - 1U)] = target->rx_buf[i];
	}

	if (len > 1U) {
		LOG_INF("%s: wrote %u bytes at reg 0x%02x first=%02x %02x %02x", target->dev->name,
			len - 1U, reg, target->rx_buf[1], len > 2U ? target->rx_buf[2] : 0U,
			len > 3U ? target->rx_buf[3] : 0U);
	} else {
		LOG_INF("%s: selected reg 0x%02x", target->dev->name, reg);
		if (reg == 0x00U) {
			/* CTS TE2 private-read checks still consume the reg-0/default stream on
			 * this IP. Mirror the latest TE2 expected bytes there before arming it.
			 */
			cts_mirror_te2_fallback(target);
		}
	}

	target->rx_len = 0U;
}

static void cts_worker(void *p1, void *p2, void *p3)
{
	struct cts_target *target = p1;
	int idx = (int)(uintptr_t)p2;
	int ret;

	ARG_UNUSED(p3);

	k_sem_init(&target->stop_sem, 0, 1);
	k_mutex_init(&target->lock);
	cts_reset_regs(target);

	cts_configure_ip();

	if (!device_is_ready(target->dev)) {
		LOG_ERR("%s not ready", target->dev->name);
		return;
	}

	ret = i3c_target_register(target->dev, &target->cfg);
	if (ret != 0) {
		LOG_ERR("%s: target register failed (%d)", target->dev->name, ret);
		return;
	}

	/* Re-apply after target registration in case the generic driver init/register
	 * path rewrote IPCR/CAPS. Keep this sample-only; do not change the driver for
	 * CTS diagnostics.
	 */
	cts_configure_ip();

	cts_registry[idx] = target;
	LOG_INF("%s: CTS register target ready", target->dev->name);

	/* Default response for CTS direct/private read cases without a prior write. */
	(void)cts_preload_response(target);

	while (1) {
		uint32_t isr;
		uint32_t risr;
		uint32_t latch;

		k_sem_take(&target->stop_sem, K_FOREVER);

		isr = cts_reg_read(CTS_ISR_OFFSET);
		risr = cts_reg_read(CTS_RISR_OFFSET);
		latch = (isr | risr) & CTS_ISR_LATCH_MASK;

		if (latch != 0U) {
			cts_log_ip_state("CTS target error latched");
			/* Keep PARE/TEx latched so the IP can NACK the next CTS transfer.
			 * Drop bytes from the malformed write locally, but do not issue ICR.TEx,
			 * ICR.PARE, or CSTR.FLUSH from the worker.
			 */
			k_mutex_lock(&target->lock, K_FOREVER);
			target->rx_len = 0U;
			cts_prepare_response(target);
			k_mutex_unlock(&target->lock);
			(void)cts_preload_response(target);
			continue;
		}

		if ((isr & CTS_ISR_DDRE) != 0U) {
			cts_log_ip_state("CTS non-SDR error before recovery");
			cts_recover_ip(true);
			cts_configure_ip();
			k_mutex_lock(&target->lock, K_FOREVER);
			target->rx_len = 0U;
			k_mutex_unlock(&target->lock);
		}

		k_mutex_lock(&target->lock, K_FOREVER);
		if (target->rx_len == 0U && cts_is_packed_reg(target->current_reg)) {
			/* A STOP with no RX bytes is a completed controller read.  CTS TE2 reads
			 * the packed two-byte registers back-to-back, so arm the next pair once
			 * the current pair has been consumed.
			 */
			target->current_reg = (uint8_t)(target->current_reg + CTS_PACKED_REG_STEP);
			LOG_INF("%s: read complete, next reg=0x%02x", target->dev->name,
				target->current_reg);
		} else {
			cts_apply_write(target);
		}
		cts_prepare_response(target);
		k_mutex_unlock(&target->lock);

		(void)cts_preload_response(target);
	}
}

#define CTS_TARGET_DEFINE(idx)                                                                     \
	static struct cts_target cts_##idx = {                                                     \
		.dev = DEVICE_DT_GET(DT_ALIAS(i3c_target_##idx)),                                  \
		.cfg = {.callbacks = &cts_callbacks},                                              \
	};                                                                                         \
	K_THREAD_DEFINE(cts_thread_##idx, CTS_THREAD_STACK, cts_worker, &cts_##idx,                \
			(void *)(uintptr_t)(idx), NULL, CTS_THREAD_PRIO, 0, CTS_THREAD_DELAY)

#define CTS_TARGET_IF_ALIAS(idx)                                                                   \
	COND_CODE_1(DT_NODE_HAS_STATUS(DT_ALIAS(i3c_target_##idx), okay),                          \
		    (CTS_TARGET_DEFINE(idx);), ())

CTS_TARGET_IF_ALIAS(0)
CTS_TARGET_IF_ALIAS(1)
CTS_TARGET_IF_ALIAS(2)
CTS_TARGET_IF_ALIAS(3)

static struct cts_target *cts_target_get(size_t idx)
{
	if (idx >= CTS_MAX_TARGETS) {
		return NULL;
	}

	return cts_registry[idx];
}

static int cmd_cts_dump(const struct shell *sh, size_t argc, char **argv)
{
	uint32_t idx = 0U;
	uint32_t reg = 0U;
	uint32_t len = 16U;
	struct cts_target *target;

	if (argc > 1) {
		idx = strtoul(argv[1], NULL, 0);
	}
	if (argc > 2) {
		reg = strtoul(argv[2], NULL, 0);
	}
	if (argc > 3) {
		len = strtoul(argv[3], NULL, 0);
	}

	target = cts_target_get(idx);
	if (target == NULL) {
		shell_error(sh, "no CTS target %u", idx);
		return -ENODEV;
	}

	if (len > CTS_REG_SIZE) {
		len = CTS_REG_SIZE;
	}

	k_mutex_lock(&target->lock, K_FOREVER);
	for (uint32_t off = 0U; off < len; off += 16U) {
		char line[80];
		int pos = snprintk(line, sizeof(line), "%02x:", (uint8_t)(reg + off));
		uint32_t chunk = MIN(16U, len - off);

		for (uint32_t i = 0U; i < chunk && pos < sizeof(line); i++) {
			pos += snprintk(line + pos, sizeof(line) - pos, " %02x",
					target->regs[(uint8_t)(reg + off + i)]);
		}
		shell_print(sh, "%s", line);
	}
	k_mutex_unlock(&target->lock);

	return 0;
}

static int cmd_cts_regs(const struct shell *sh, size_t argc, char **argv)
{
	ARG_UNUSED(argc);
	ARG_UNUSED(argv);

	shell_print(sh, "IPCR=0x%08x", cts_reg_read(CTS_IPCR_OFFSET));
	shell_print(sh, "CSTR=0x%08x", cts_reg_read(CTS_CSTR_OFFSET));
	shell_print(sh, "CSR =0x%08x", cts_reg_read(CTS_CSR_OFFSET));
	shell_print(sh, "ISR =0x%08x", cts_reg_read(CTS_ISR_OFFSET));
	shell_print(sh, "RISR=0x%08x", cts_reg_read(CTS_RISR_OFFSET));
	shell_print(sh, "IMR =0x%08x", cts_reg_read(CTS_IMR_OFFSET));
	shell_print(sh, "TRINF=0x%08x", cts_reg_read(CTS_TRINF_OFFSET));
	shell_print(sh, "CAPS=0x%08x", cts_reg_read(CTS_CAPS_OFFSET));

	return 0;
}

static int cmd_cts_recover(const struct shell *sh, size_t argc, char **argv)
{
	ARG_UNUSED(argc);
	ARG_UNUSED(argv);

	cts_recover_ip(true);
	cts_configure_ip();
	shell_print(sh, "CTS IP recovery triggered, error latch cleared, and policy re-applied");

	return 0;
}

static int cmd_cts_configure(const struct shell *sh, size_t argc, char **argv)
{
	ARG_UNUSED(argc);
	ARG_UNUSED(argv);

	cts_configure_ip();
	shell_print(sh, "CTS IP policy re-applied");

	return 0;
}

static int cmd_cts_reset(const struct shell *sh, size_t argc, char **argv)
{
	uint32_t idx = 0U;
	struct cts_target *target;

	if (argc > 1) {
		idx = strtoul(argv[1], NULL, 0);
	}

	target = cts_target_get(idx);
	if (target == NULL) {
		shell_error(sh, "no CTS target %u", idx);
		return -ENODEV;
	}

	k_mutex_lock(&target->lock, K_FOREVER);
	cts_reset_regs(target);
	k_mutex_unlock(&target->lock);

	(void)cts_preload_response(target);
	shell_print(sh, "CTS target %u reset", idx);

	return 0;
}

SHELL_STATIC_SUBCMD_SET_CREATE(
	cts_cmds, SHELL_CMD_ARG(configure, NULL, "re-apply CTS IP policy", cmd_cts_configure, 1, 0),
	SHELL_CMD_ARG(dump, NULL, "dump [target_idx] [reg] [len]", cmd_cts_dump, 1, 3),
	SHELL_CMD_ARG(recover, NULL, "flush/recover the I3C IP", cmd_cts_recover, 1, 0),
	SHELL_CMD_ARG(regs, NULL, "show CTS-related I3C registers", cmd_cts_regs, 1, 0),
	SHELL_CMD_ARG(reset, NULL, "reset [target_idx]", cmd_cts_reset, 1, 1),
	SHELL_SUBCMD_SET_END);

SHELL_CMD_REGISTER(i3c_target_cts, &cts_cmds, "I3C target CTS/register sample", NULL);
