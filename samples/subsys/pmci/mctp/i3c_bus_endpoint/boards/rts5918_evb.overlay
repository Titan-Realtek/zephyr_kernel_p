/*
 * Copyright (c) 2026 Realtek Semiconductor Corp.
 * SPDX-License-Identifier: Apache-2.0
 *
 * rts5918_evb as an MCTP-over-I3C endpoint (I3C target) on i3c4.
 * Pair with a second rts5918_evb running the i3c_bus_owner sample:
 * wire the two boards' i3c4 SCL/SDA together, add bus pull-ups, and
 * share a common ground.
 */

&i3c4 {
	status = "okay";
	target-mode;
	pinctrl-0 = <&i3c04_scl_gpio014 &i3c04_sda_gpio017
		     &i3c04_scl_gpio014_pin_sel &i3c04_sda_gpio017_pin_sel>;
	pinctrl-names = "default";
	static-addr = <0x31>;
	pid-msb = <0x04ba>;
	pid-lsb = <0x00001004>;
	bcr = <0x16>;		/* IBI request-capable + IBI payload (MCTP needs it) */
	dcr = <0xc2>;
	max-read-len = <256>;
	max-write-len = <256>;
};

/ {
	mctp_i3c: mctp_i3c {
		compatible = "zephyr,mctp-i3c-target";
		i3c = <&i3c4>;
		endpoint-id = <11>;
	};
};
