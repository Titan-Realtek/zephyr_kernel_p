## drivers/clock_control/Kconfig.rts5918
```kconfig
# SPDX-License-Identifier: Apache-2.0
#
# Copyright (c) 2024 Realtek Semiconductor Corporation, SIBG-SD7
#

config CLOCK_CONTROL_RTS5918_SCCON
	bool "Realtek RTS5918 system clock controller driver"
	depends on SOC_SERIES_RTS5918
	default y if DT_HAS_REALTEK_RTS5918_SCCON_ENABLED
	help
	  Enable support for RTS5918 system clock controller driver
```

## dts/bindings/clock/realtek,rts5918-sccon.yaml
```yaml
# SPDX-License-Identifier: Apache-2.0
#
# Copyright (c) 2024 Realtek Semiconductor Corporation, SIBG-SD7
#

description: Realtek RTS5918 System Clock Controller (SCCON)

compatible: "realtek,rts5918-sccon"

include: [clock-controller.yaml, base.yaml]

properties:
  reg:
    required: true

  "#clock-cells":
    const: 2

clock-cells:
  - clk-grp
  - clk-idx
```

## soc/realtek/ec/rts5918/Kconfig
```kconfig
# SPDX-License-Identifier: Apache-2.0
#
# Copyright (c) 2024 Realtek Semiconductor Corporation, SIBG-SD7
#

config SOC_SERIES_RTS5918
	select ARM
	select CPU_CORTEX_M33
	select SYS_CLOCK_EXISTS
	select DYNAMIC_INTERRUPTS
	select SOC_EARLY_INIT_HOOK

if SOC_SERIES_RTS5918

config RTS5918_ON_ENTER_CPU_IDLE_HOOK
	bool "CPU idle hook enable"
	default y
	imply ARM_ON_ENTER_CPU_IDLE_HOOK
	help
	  Enables a hook (z_arm_on_enter_cpu_idle()) that is called when
	  the CPU is made idle (by k_cpu_idle() or k_cpu_atomic_idle()).
	  If needed, this hook can be used to prevent the CPU from actually
	  entering sleep by skipping the WFE/WFI instruction.

config RTS5918_DEBUG_SWJ
	bool "Serial wire JTAG"
	default y
	depends on DT_HAS_SWJ_CONNECTOR_ENABLED
	help
	  Enables the serial wire JTAG connection on the RTS5918 EC.

config SOC_RTS5918_ULPM
	bool "Realtek RTS5918 ULPM (Ultra Low Power Mode)"
	default y
	depends on DT_HAS_REALTEK_RTS5918_ULPM_ENABLED
	select HAS_POWEROFF
	help
	  Enable support for RTS5918 ULPM PWR wake-up pins.

endif # SOC_SERIES_RTS5918
```

## soc/realtek/ec/rts5918/Kconfig.defconfig.series
```kconfig
# SPDX-License-Identifier: Apache-2.0
#
# Copyright (c) 2024 Realtek Semiconductor Corporation, SIBG-SD7
#

if SOC_SERIES_RTS5918

config NUM_IRQS
	default 240

rsource "Kconfig.defconfig.rts5918"

endif # SOC_SERIES_RTS5918
```

## soc/realtek/ec/rts5918/Kconfig.soc
```kconfig
# SPDX-License-Identifier: Apache-2.0
#
# Copyright (c) 2024 Realtek Semiconductor Corporation, SIBG-SD7
#

config SOC_SERIES_RTS5918
	bool
	select SOC_FAMILY_REALTEK_EC
	help
	  Enable support for REALTEK EC MCU series

config SOC_SERIES
	default "rts5918" if SOC_SERIES_RTS5918

config SOC_RTS5918
	bool
	select SOC_SERIES_RTS5918

config SOC
	default "rts5918" if SOC_RTS5918
```
