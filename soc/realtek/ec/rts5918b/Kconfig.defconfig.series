## soc/realtek/ec/rts5918b/Kconfig.defconfig.series
```kconfig
# SPDX-License-Identifier: Apache-2.0
#
# Copyright (c) 2026 Realtek Semiconductor Corporation, SIBG-SD7
#

if SOC_SERIES_RTS5918B

config NUM_IRQS
	default 240

rsource "Kconfig.defconfig.rts5918b"

endif # SOC_SERIES_RTS5918B
```
